## ports/busybox/adros_defconfig
```kconfig
#
# AdrOS minimal Busybox configuration
#
# Start with this defconfig and expand as needed.
# Build: make CROSS_COMPILE=i686-adros- O=build defconfig
#        cp adros_defconfig build/.config
#        make CROSS_COMPILE=i686-adros- O=build oldconfig
#
CONFIG_STATIC=y
CONFIG_CROSS_COMPILER_PREFIX="i686-adros-"
CONFIG_EXTRA_CFLAGS="-Os -D_POSIX_VERSION=200112L"
CONFIG_EXTRA_LDFLAGS="-static"

# ---- Core applets ----
CONFIG_ASH=y
CONFIG_ASH_BASH_COMPAT=y
CONFIG_ASH_JOB_CONTROL=y
CONFIG_ASH_ALIAS=y
CONFIG_ASH_BUILTIN_ECHO=y
CONFIG_ASH_BUILTIN_PRINTF=y
CONFIG_ASH_BUILTIN_TEST=y
CONFIG_ASH_CMDCMD=y
CONFIG_ASH_EXPAND_PRMT=y
CONFIG_ASH_GETOPTS=y
CONFIG_ASH_OPTIMIZE_FOR_SIZE=y

# ---- File utilities ----
CONFIG_LS=y
CONFIG_CAT=y
CONFIG_CP=y
CONFIG_MV=y
CONFIG_RM=y
CONFIG_MKDIR=y
CONFIG_RMDIR=y
CONFIG_LN=y
CONFIG_CHMOD=y
CONFIG_CHOWN=y
CONFIG_TOUCH=y
CONFIG_HEAD=y
CONFIG_TAIL=y
CONFIG_WC=y
CONFIG_DD=y
CONFIG_TEE=y
CONFIG_STAT=y

# ---- Text utilities ----
CONFIG_GREP=y
CONFIG_SED=y
CONFIG_AWK=y
CONFIG_SORT=y
CONFIG_UNIQ=y
CONFIG_CUT=y
CONFIG_TR=y
CONFIG_ECHO=y
CONFIG_PRINTF=y
CONFIG_YES=y
CONFIG_TRUE=y
CONFIG_FALSE=y

# ---- Process utilities ----
CONFIG_PS=y
CONFIG_KILL=y
CONFIG_SLEEP=y

# ---- System utilities ----
CONFIG_MOUNT=y
CONFIG_UMOUNT=y
CONFIG_UNAME=y
CONFIG_HOSTNAME=y
CONFIG_ID=y
CONFIG_WHOAMI=y
CONFIG_PWD=y
CONFIG_BASENAME=y
CONFIG_DIRNAME=y
CONFIG_ENV=y
CONFIG_PRINTENV=y
CONFIG_TEST=y
CONFIG_EXPR=y
CONFIG_SEQ=y
CONFIG_CLEAR=y
CONFIG_RESET=y
CONFIG_XARGS=y
CONFIG_FIND=y
CONFIG_WHICH=y

# ---- Disable features not yet supported ----
# CONFIG_FEATURE_EDITING is not set
# CONFIG_FEATURE_SH_NOFORK is not set
# CONFIG_FEATURE_NETWORKING is not set
# CONFIG_IFCONFIG is not set
# CONFIG_PING is not set
# CONFIG_WGET is not set
# CONFIG_TELNET is not set
# CONFIG_SYSLOGD is not set
# CONFIG_KLOGD is not set
# CONFIG_INIT is not set
# CONFIG_HALT is not set
# CONFIG_REBOOT is not set
# CONFIG_POWEROFF is not set
```
